## main/Kconfig.projbuild
```kconfig
menu "Wake Word Audio"

config WAKE_MODEL_MANIFEST
    string "Wake word model manifest (under models/)"
    default ""
    help
        Model manifest file to embed, e.g. "hi_circle_v1.json". Each manifest
        is one wake word/version, and names its .tflite in its "model" field.
        Leave empty for automatic selection: the only *.json in models/, or
        (if there are several) the alphabetically first one, with a build warning.
        Switch models here when testing different wake words; the next build
        relinks the firmware with the chosen model.

config WAKE_MIC_GAIN
    int "Microphone input gain (dB)"
    range 0 37
    default 24
    help
        ES7210 input-channel gain passed to esp_codec_dev_set_in_channel_gain.

config WAKE_SPEAKER_VOLUME
    int "Speaker output volume (0-100)"
    range 0 100
    default 40
    help
        ES8311 output volume passed to esp_codec_dev_set_out_vol.

endmenu
```
